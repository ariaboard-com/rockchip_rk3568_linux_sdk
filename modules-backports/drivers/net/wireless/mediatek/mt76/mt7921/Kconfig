## modules-backports/drivers/net/wireless/mediatek/mt76/mt7921/Kconfig
```kconfig
# SPDX-License-Identifier: ISC
config MT7921E
	depends on !KERNEL_4_6
	tristate "MediaTek MT7921E (PCIe) support"
	depends on m
	select MT76_CONNAC_LIB
	select BPAUTO_WANT_DEV_COREDUMP
	depends on MAC80211
	depends on PCI
	help
	  This adds support for MT7921E 802.11ax 2x2:2SS wireless devices.

	  To compile this driver as a module, choose M here.
```
